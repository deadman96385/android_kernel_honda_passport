/*
 * Copyright (C) 2013 Texas Instruments Incorporated - http://www.ti.com/
 *
 * This program is free software; you can redistribute it and/or modify
 * it under the terms of the GNU General Public License version 2 as
 * published by the Free Software Foundation.
 */

#include "dra7-evm.dts"
#include "dra7xx-evm-lcd10.dtsi"
/{
	bcmdhd_wlan_0: bcmdhd_wlan@0 {
		compatible = "android,bcmdhd_wlan";
		gpios = <&gpio5 7 0>;   /* gpio5_7 */
		wlreg_on-supply = <&vmmcwl_fixed>;
	};

};
&ldc3001 {
	interrupt-parent = <&gpio1>;
	interrupts = <2 IRQ_TYPE_LEVEL_HIGH>;
};

&vmmcwl_fixed {
	regulator-min-microvolt = <3300000>;
	regulator-max-microvolt = <3300000>;
};
