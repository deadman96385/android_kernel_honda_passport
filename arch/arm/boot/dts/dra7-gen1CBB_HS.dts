/*
 * Copyright (C) 2015 DENSO INTERNATIONAL AMERICA
 *
 * This program is free software; you can redistribute it and/or modify
 * it under the terms of the GNU General Public License version 2 as
 * published by the Free Software Foundation.
 */

#include "dra7-gen1CBB.dts"
#include "dra7-hs.dtsi"

