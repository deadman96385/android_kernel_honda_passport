/*
 * Copyright (C) 2013 Texas Instruments Incorporated - http://www.ti.com/
 *
 * This program is free software; you can redistribute it and/or modify
 * it under the terms of the GNU General Public License version 2 as
 * published by the Free Software Foundation.
 */

#include "dra7-gen1CBB.dts"

/ {
	model = "DENSO LOW DRA745";
	compatible = "denso,dra74xlow", "ti,dra742", "ti,dra74", "ti,dra7";
};
