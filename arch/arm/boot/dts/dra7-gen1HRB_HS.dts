/*********************************************************
*
*  Copyright (c) 2015 Honda R&D Americas, Inc.
*  All rights reserved. You may not copy, distribute, publicly display,
*  create derivative works from or otherwise use or modify this
*  software without first obtaining a license from Honda R&D Americas, Inc.
*
*********************************************************/

#include "dra7-gen1HRB.dts"
#include "dra7-hs.dtsi"



