## drivers/misc/denso_hw_ctrl/Kconfig
```kconfig
comment "DENSO Hardware Control"

config DENSO_HW_CTRL
	tristate "DENSO proprietary hardware control for HONDA battery disconnect, nor parameters"
	depends on I2C
	default n
	help
	  A DENSO proprietary module. Say m when you want to support this tool.
```

## drivers/mlb/Kconfig
```kconfig
config MLB150
	tristate "Media Local Bus Driver"
	default y
	---help---
	  MLB (MOST) Driver.
	  Just say Y.

choice
	prompt "MLB Device Driver type"
	default MLB150_J6
	depends on MLB150

config MLB150_J6
	tristate "Device Tree J6 Config for MLB Driver"
	---help---
	  Configuration code specific to TI Jacinto6 MLB support,
	  using device tree (Open Firmware) for hardware configuration.

config MLB150_J6HARD
	tristate "Hardcoded J6 Config for MLB Driver"
	---help---
	  Configuration code specific to TI Jacinto6 MLB support,
	  using hardcoded values for hardware configuration.

endchoice

config MLB150_CPU_AFFINITY
	int "MLB Interrupt CPU Affinity"
	depends on MLB150
	default -1
	---help---
	  Bind MLB interrupts and worker thread to this CPU.  Use -1 to
	  indicate that all CPUs can handle MLB interrupts.

config MLB150_DEBUG_POISON
	bool "Poison Buffers"
	default n
	---help---
	  Poison DMA buffers for debugging.
```

## security/smc/dra7x/Kconfig
```kconfig
config TF_ZEBRA
	bool

config SECURITY_MIDDLEWARE_COMPONENT
	tristate "Enable SMC Driver"
	depends on ARCH_OMAP4 || SOC_OMAP5 || SOC_DRA7XX
	select TF_ZEBRA
        select CRYPTO_SHA1
	help
	  This option adds kernel support for communication with the SMC
	  Protected Application.

	  If you are unsure how to answer this question, answer N.

config SMC_KERNEL_CRYPTO
	bool "Register SMC into kernel crypto subsytem"
	depends on SECURITY_MIDDLEWARE_COMPONENT
	help
	  This option enables crypto subsystem to use SMC and OMAP hardware
	  accelerators.

	  If you are unsure how to answer this question, answer Y.

config SECURE_TRACE
	bool "Enable SMC secure traces"
	depends on SECURITY_MIDDLEWARE_COMPONENT
	default y
	help
	  This option enables traces from the SMC Protected Application to be
	  displayed in kernel logs.

	  If you are unsure how to answer this question, answer Y.

config TF_DRIVER_DEBUG_SUPPORT
	bool "Debug support"
	depends on SECURITY_MIDDLEWARE_COMPONENT
	help
	  This option enables debug traces in the driver.

	  If you are unsure how to answer this question, answer N.

config TF_DRIVER_CRYPTO_FIPS
	bool "FIPS compliance support"
	depends on SMC_KERNEL_CRYPTO && MODULE_EXTRA_COPY
	help
          This option enables features for FIPS certification of the SMC
          cryptographic driver: built-in test vectors for POST, and a
          device for user space programs to submit more test vectors.

          If you are unsure how to answer this question, answer N.

config TF_DRIVER_FAULT_INJECTION
	bool "Fault injection support"
	depends on TF_DRIVER_CRYPTO_FIPS
	help
	  This option allows forcing cryptographic operations in the SMC
	  driver to fail.

	  If you are unsure how to answer this question, answer Y.

config TF_CRYPTO_RNG
	bool "HW RNG driver using SMC"
	depends on SECURITY_MIDDLEWARE_COMPONENT && HW_RANDOM
	help
	  This option enables HW RNG device /dev/hwrng using TF SMC's
	  GenerateRandom API.

	  If you are unsure how to answer this question, answer N.
```
